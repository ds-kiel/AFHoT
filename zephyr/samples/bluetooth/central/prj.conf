## prj.conf
```kconfig
CONFIG_BT=y
CONFIG_BT_CENTRAL=y
CONFIG_BT_MAX_CONN=2


CONFIG_BT_DEVICE_NAME="Leonardos Zephyr"
CONFIG_HAS_SEGGER_RTT=y
CONFIG_USE_SEGGER_RTT=y
CONFIG_RTT_CONSOLE=y

CONFIG_HAS_SEGGER_RTT=y
CONFIG_USE_SEGGER_RTT=y
CONFIG_RTT_CONSOLE=y
CONFIG_UART_CONSOLE=n

# CONFIG_BT_CONN=y
# CONFIG_BT_CTLR=y
# CONFIG_BT_HCI=y

#RSSI
CONFIG_BT_CTLR_ADVANCED_FEATURES=y
CONFIG_BT_CTLR_CONN_RSSI=y


# CONFIG_BT_HCI_RAW=y

# CONFIG_BT_DEBUG_LOG=y
# CONFIG_BT_DEBUG_CONN=y

# CONFIG_BT_DEBUG_MONITOR=y
# CONFIG_BT_DEBUG_HCI_CORE=y
# CONFIG_BT_DEBUG_CONN=y
# CONFIG_BT_DEBUG_KEYS=y
# CONFIG_BT_DEBUG_L2CAP=y
# CONFIG_BT_DEBUG_SMP=y
# CONFIG_BT_DEBUG_HCI_DRIVER=y

# CONFIG_BT_DEBUG_ATT=y
# CONFIG_BT_DEBUG_GATT=y
```

## src/main.c
```c
/* main.c - Application main entry point */

/*
 * Copyright (c) 2015-2016 Intel Corporation
 *
 * SPDX-License-Identifier: Apache-2.0
 */

#include <zephyr/types.h>
#include <stddef.h>
#include <errno.h>
#include <zephyr.h>
#include <sys/printk.h>

#include <bluetooth/bluetooth.h>
#include <bluetooth/hci.h>
#include <bluetooth/conn.h>
#include <bluetooth/uuid.h>
#include <bluetooth/gatt.h>
#include <sys/byteorder.h>

#include <stdio.h>
#include <string.h>

static struct bt_conn *default_conn;

static void device_found(const bt_addr_le_t *addr, s8_t rssi, u8_t type,
			 struct net_buf_simple *ad)
{
	char addr_str[BT_ADDR_LE_STR_LEN];


	if (default_conn) {
		return;
	}

	/* We're only interested in connectable events */
	if (type != BT_LE_ADV_IND && type != BT_LE_ADV_DIRECT_IND) {
	    printk("Unconnectable address %s found\n", addr_str);
		return;
	}

	bt_addr_le_to_str(addr, addr_str, sizeof(addr_str));
	printk("Device found: %s (RSSI %d)\n", addr_str, rssi);

  if (strstr(addr_str, "f0:18:98:47:1e:9a") != NULL) {
    printk("Found Leonardos laptop\n");
    bt_le_scan_stop();
    default_conn = bt_conn_create_le(addr, BT_LE_CONN_PARAM_DEFAULT);
    if(default_conn != NULL) {
        printk("Connected!");
    } else {
        printk("Connection failed!");
    }

  } else {
    return;
  }

	/* connect only to devices in close proximity */
	if (rssi < -70) {
		return;
	}




}

static void connected(struct bt_conn *conn, u8_t err)
{
	char addr[BT_ADDR_LE_STR_LEN];

	bt_addr_le_to_str(bt_conn_get_dst(conn), addr, sizeof(addr));

  printk("IN CONNECT CALLBACK\n");
  
	if (err) {
		printk("Failed to connect to %s (%u)\n", addr, err);
		return;
	}

	if (conn != default_conn) {
		return;
	}

	printk("Connected: %s\n", addr);

	// bt_conn_disconnect(conn, BT_HCI_ERR_REMOTE_USER_TERM_CONN);
}

static void disconnected(struct bt_conn *conn, u8_t reason)
{
	char addr[BT_ADDR_LE_STR_LEN];
	int err;

	if (conn != default_conn) {
		return;
	}

	bt_addr_le_to_str(bt_conn_get_dst(conn), addr, sizeof(addr));

	printk("Disconnected: %s (reason 0x%02x)\n", addr, reason);

	bt_conn_unref(default_conn);
	default_conn = NULL;

	/* This demo doesn't require active scan */
	err = bt_le_scan_start(BT_LE_SCAN_PASSIVE, device_found);
	if (err) {
		printk("Scanning failed to start (err %d)\n", err);
	}
}

static struct bt_conn_cb conn_callbacks = {
		.connected = connected,
		.disconnected = disconnected,
};

void main(void)
{
	int err;

	err = bt_enable(NULL);
	if (err) {
		printk("Bluetooth init failed (err %d)\n", err);
		return;
	}

	printk("Bluetooth initialized\n");

	bt_conn_cb_register(&conn_callbacks);

  int chm_err;
  u8_t chm[5] = { 0xaf, 0xfa, 0xbf, 0xfb, 0xf3 };
  chm_err = bt_le_set_chan_map(chm);

  if (chm_err) {
    printk("Channel map update failed (err %d)\n", chm_err);
  } else {
    printk("Channel map update successful\n");
  }

	err = bt_le_scan_start(BT_LE_SCAN_ACTIVE, device_found);
	if (err) {
		printk("Scanning failed to start (err %d)\n", err);
		return;
	}

	printk("Scanning successfully started\n");
}
```
